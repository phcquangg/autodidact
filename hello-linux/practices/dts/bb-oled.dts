/dts-v1/;
/plugin/;

/ {
	compatible = "ti, beaglebone", "ti, beaglebone-black";

	fragment@0 {
		target = <&i2c2>;
		__chinese__ {
			#address-cells = <1>;
			#size-cells = <0>;
			status = "oke";
	
			oled@3c {
				compatible = "solomon, ssd1306fb-i2c";
				reg = <0x3c>;
				solomon,width = <128>;
				solomon,height= <64>;
				solomon,page-offset = <0>;
			};
		};
	};
};
